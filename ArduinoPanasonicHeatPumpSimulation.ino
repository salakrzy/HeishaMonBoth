/*
  SerialPassthrough sketch

  Some boards, like the Arduino 101, the MKR1000, Zero, or the Micro, have one
  hardware serial port attached to Digital pins 0-1, and a separate USB serial
  port attached to the IDE Serial Monitor. This means that the "serial
  passthrough" which is possible with the Arduino UNO (commonly used to interact
  with devices/shields that require configuration via serial AT commands) will
  not work by default.

  This sketch allows you to emulate the serial passthrough behaviour. Any text
  you type in the IDE Serial monitor will be written out to the serial port on
  Digital pins 0 and 1, and vice-versa.

  On the 101, MKR1000, Zero, and Micro, "Serial" refers to the USB Serial port
  attached to the Serial Monitor, and "Serial1" refers to the hardware serial
  port attached to pins 0 and 1. This sketch will emulate Serial passthrough
  using those two Serial ports on the boards mentioned above, but you can change
  these names to connect any two serial ports on a board that has multiple ports.

  created 23 May 2016
  by Erik Nyquist

  https://www.arduino.cc/en/Tutorial/BuiltInExamples/SerialPassthrough
*/
#define QUERYSIZE 222
byte mainQuery[]    =   {0x71, 0x6c, 0x01, 0x10, 0x00, 0x00, 0x00, 0x00, 0x00, 0x00, 0x00, 0x00, 0x00,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 0x00, 0x11};
byte initialQuery[] = {0x31, 0x05, 0x10, 0x01, 0x00, 0x00, 0x00, 0xB9};
byte initialResponse[]= {0x31, 0x30, 0x01, 0x10, 0x1E, 0x6C, 0xC8, 0x00, 0x00, 0x00, 0x00, 0x00, 0x00,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 0x00, 0x3C};
byte cleanCommand[222];
byte pumpAnswer[] = {0x71, 0xc8, 0x01, 0x10, 0x56, 0x55, 0x62, 0x49, 0x00, 0x05, 0x00, 0x00, 0x00,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 0x00, 0x77};
byte pumpAnswer1[]= {0xf1, 0x6c, 0x01, 0x10, 0x00, 0x00, 0x00, 0x00, 0x00, 0x00, 0x00, 0x00, 0x00,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 0x00, 0x46};
int index=0;
bool start=false;
/*
byte calculate_checksum(byte* command) 
{
  byte chk = 0;
  for ( int i = 0; i < QUERYSIZE; i++) chk += command[i];
  chk = (chk ^ 0xFF) + 01;
  return chk;
}
*/

void setup() 
{
  Serial.begin(9600,SERIAL_8E2);
Serial.print(" koniec pytania bajtów= ");  
//for (int j=0; j<=202;j++)  Serial.write((byte) pumpAnswer[j]); 
cleanCommand[0]=0x00; 
Serial.flush();

}

void loop() 
{

  int wska=0;
  if (Serial.available())
      {
      while (Serial.available()) 
      {    cleanCommand[wska]=Serial.read();
//            Serial.print( cleanCommand[wska],HEX); 
            ++wska;
      delay(2);
      } 

//    Serial.print(" koniec pytania bajtów= ");
//    Serial.println(wska);


    if (cleanCommand[0]==byte(0x71) )
    {
      for (int j=0; j<=202;j++)  Serial.write((byte) pumpAnswer[j]); 
      cleanCommand[0]=0x00;      
//          Serial.println(" 0x71");
    }
    if (cleanCommand[0]==byte(0xF1))
    {
      for (int j=0; j<=202;j++)  Serial.write((byte) pumpAnswer[j]); 
      cleanCommand[0]=0x00;  
//                Serial.println(" 0xF1");
    }
    if (cleanCommand[0]==byte(0x31))
    {
      for (int j=0; j<=50;j++)  Serial.write((byte) initialResponse[j]); 
      start=true;
      cleanCommand[0]=0x00;  
//                Serial.println(" 0x31");
    }
    else { 
 //     Serial.print(" nic nie odebrałem");
      }
            
  Serial.flush();
  delay(50);    
}
}


