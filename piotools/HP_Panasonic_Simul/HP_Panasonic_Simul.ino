/*

This is very simply sketch to emulate communication with Aquarea Panasonic Heat Pump.
*/
#include <ModbusRtu.h>
#include <SoftwareSerial.h>

#define QUERYSIZE 222
byte mainQuery[]    =   {0x71, 0x6c, 0x01, 0x10, 0x00, 0x00, 0x00, 0x00, 0x00, 0x00, 0x00, 0x00, 0x00,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 0x00, 0x11};
byte initialQuery[] = {0x31, 0x05, 0x10, 0x01, 0x00, 0x00, 0x00, 0xB9};
byte initialResponse[]= {0x31, 0x30, 0x01, 0x10, 0x1E, 0x6C, 0xC8, 0x00, 0x00, 0x00, 0x00, 0x00, 0x00,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 0x00, 0x3C};
byte cleanCommand[222];
byte pumpAnswer[] =  {0x71, 0xc8, 0x01, 0x10, 0x56, 0x55, 0x62, 0x49, 0x00, 0x05, 0x00, 0x00, 0x00,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 0x00, 0x77};
byte pumpMaxAnswer[]={0x71, 0xC8, 0x01, 0x21, 0x8A, 0xEA, 0x01, 0x00, 0x00, 0x00, 0x00, 0x00, 0x00,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 0x00, 0xA3};
byte pumpPCBAnswer[]={0xf1, 0x6c, 0x01, 0x10, 0x00, 0x00, 0x00, 0x00, 0x00, 0x00, 0x00, 0x00, 0x00,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 0x00, 0x46};
byte pumpAnswer1[]= {0xf1, 0x6c, 0x01, 0x10, 0x00, 0x00, 0x00, 0x00, 0x00, 0x00, 0x00, 0x00, 0x00,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 0x00, 0x46};
byte pumpPCBConfirm[]={0x71 , 0x11 , 0x01 , 0x50 , 0x00 , 0x00 , 0x00 , 0x00 , 0x00 , 0x00 , 0x00 , 0x00 , 0x00 , 0x00 , 0x00 , 0x00 , 0x00 , 0x00 , 0x00 , 0x2D};
byte SETpumpAnswer[] =  {0xF1, 0xc8, 0x01, 0x10, 0x56, 0x55, 0x62, 0x49, 0x00, 0x05, 0x00, 0x00, 0x00,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 0x00, 0x77};
int index=0;
unsigned long czas;  
bool start=false;
byte crc;

byte calculate_checksum(byte* command, int size) 
{
  byte chk = 0;
  for ( int i = 0; i < size; i++) chk += command[i];
  chk = (chk ^ 0xFF) + 01;
  return chk;
}

//MUDBUS DEFINITION
//source https://github.com/smarmengol/Modbus-Master-Slave-for-Arduino/blob/master/examples/software_serial_simple_master/software_serial_simple_master.ino

// data array for modbus network sharing
uint16_t au16data[16];
uint8_t u8state;

SoftwareSerial mySerial(8, 7);//Create a SoftwareSerial object so that we can use software serial. Search "software serial" on Arduino.cc to find out more details.

/**
 *  Modbus object declaration
 *  u8id : node id = 0 for master, = 1..247 for slave
 *  port : serial port
 *  u8txenpin : 0 for RS-232 and USB-FTDI 
 *               or any pin number > 1 for RS-485
 */
Modbus master(0, mySerial,3); // this is master and RS-232 or USB-FTDI via software serial

/**
 * This is an structe which contains a query to an slave device
 */
modbus_t telegram;

unsigned long u32wait;

void setup() 
{
	mySerial.begin(9600);//use the hardware serial if you want to connect to your computer via usb cable, etc.
	master.start(); // start the ModBus object.
	master.setTimeOut( 2000 ); // if there is no answer in 2000 ms, roll over
	u32wait = millis() + 1000;
	u8state = 0; 

	Serial.begin(9600,SERIAL_8E2);
	cleanCommand[0]=0x00; 
	pinMode(LED_BUILTIN, OUTPUT);
	pinMode(12, INPUT_PULLUP);
	pinMode(5, OUTPUT);
	pinMode(6, OUTPUT);  
	digitalWrite(5, LOW);
	digitalWrite(6, LOW); 
	Serial.flush();
}

void loop() 
{
  int sensorVal = digitalRead(12);
  int wska=0;
  if (Serial.available())
      {
      while (Serial.available()) 
      {    cleanCommand[wska]=Serial.read();
//            Serial.print( cleanCommand[wska],HEX); 
            ++wska;
      if (!Serial.available()) delay(4);
      } 
    if (cleanCommand[0]==byte(0x71) )
    {
	  if (sensorVal == HIGH) {
      crc=calculate_checksum(pumpAnswer, 201); 
      for (int j=0; j<=201;j++)  Serial.write((byte) pumpAnswer[j]); 
      Serial.write(crc); 
      cleanCommand[0]=0x00;   
      digitalWrite(LED_BUILTIN, HIGH);	  
//      Serial.println(" 0x71");
	} else {
      crc=calculate_checksum(pumpMaxAnswer, 201); 
      for (int j=0; j<=201;j++)  Serial.write((byte) pumpMaxAnswer[j]);       
      Serial.write(crc); 
      cleanCommand[0]=0x00;   
      digitalWrite(LED_BUILTIN, LOW);	  
//          Serial.println(" 0x71");
    }
	}
    if (cleanCommand[0]==byte(0xF1)and cleanCommand[3]==byte(0x50))
    {
      for (int j=0; j<=19;j++)  Serial.write((byte) pumpPCBConfirm[j]); 
      cleanCommand[0]=0x00;  
//                Serial.println(" PCB");
    }
    if (cleanCommand[0]==byte(0x31))
    {
      crc=calculate_checksum(initialResponse, 49); 
      for (int j=0; j<=49;j++)  Serial.write((byte) initialResponse[j]);
      Serial.write(crc);  
      start=true;
      cleanCommand[0]=0x00;  
//                Serial.println(" 0x31");
    }
     if ((cleanCommand[0]==byte(0xF1)) and (cleanCommand[77]== byte(0x46 )))
    {
      crc=calculate_checksum(pumpAnswer1, 201);       
      for (int j=0; j<=201;j++)  Serial.write((byte) pumpAnswer1[j]); 
      Serial.write(crc);  
		cleanCommand[0]=0x00;   
//      Serial.println(" 0xF1");
	}
	     if (cleanCommand[0]==byte(0xF1))
    {
      crc=calculate_checksum(SETpumpAnswer, 201);       
      for (int j=0; j<=201;j++)  Serial.write((byte) SETpumpAnswer[j]); 
      Serial.write(crc);  
		cleanCommand[0]=0x00;   
//      Serial.println(" 0xF1");
	}
    else { 
 //     Serial.print("nothing received");
      }
            
  Serial.flush();
}


      
// pin 5 and 6 for S0 nas S1 counter check
if ((millis()-czas)> 300){
  digitalWrite(5, HIGH);
  digitalWrite(6, HIGH);     
}
if ((millis()-czas)> 325){
  digitalWrite(5, LOW);
  digitalWrite(6, LOW); 
  czas=millis();    
    }

switch( u8state ) {
  case 0: 
    if (millis() > u32wait) u8state++; // wait state
    break;
  case 1: 
    telegram.u8id = 10; // slave address
    telegram.u8fct = 3; // function code (this one is registers read)
    telegram.u16RegAdd = 0; // start address in slave
    telegram.u16CoilsNo = 100; // number of elements (coils or registers) to read
    telegram.au16reg = au16data; // pointer to a memory array in the Arduino

    master.query( telegram ); // send query (only once)
    u8state++;
    break;
  case 2:
    master.poll(); // check incoming messages
    if (master.getState() == COM_IDLE) {
      u8state = 0;
      u32wait = millis() + 2000; 
      //  Serial.println(au16data[0]);//Or do something else!
    }
    break;
  }    
}


